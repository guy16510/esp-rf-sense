## firmware/main/Kconfig.projbuild
```kconfig
menu "RF-Sense Lab"

    config RF_SENSE_OTA_ALLOW_INSECURE_HTTP
        bool "Allow plain-HTTP OTA endpoints (DEVELOPMENT ONLY)"
        default n
        help
            When disabled (the default and the only production-safe setting), the OTA manager
            refuses any manifest or firmware URL that is not https://. TLS server verification
            is always performed; there is never a "skip certificate validation" path.

            Enable ONLY for local development against a plain-HTTP OTA server. Release builds
            must keep this off.

    config RF_SENSE_OTA_VERIFY_PERIOD_S
        int "Post-OTA health verification period (seconds)"
        default 30
        range 5 600
        help
            After an OTA boot the new app runs in pending-verify state. It must stay healthy
            for this many seconds (and pass all startup diagnostics) before being marked valid.
            If it fails, the bootloader rolls back to the previous slot.

    config RF_SENSE_BOOTLOOP_THRESHOLD
        int "Consecutive failed boots that trigger rollback"
        default 3
        range 2 10
        help
            If this many consecutive boots fail to reach a healthy state, the device marks the
            running image invalid and rolls back.

    choice RF_SENSE_IDENTIFY_LED_TYPE
        prompt "Receiver identify LED type"
        default RF_SENSE_IDENTIFY_LED_TYPE_WS2812 if IDF_TARGET_ESP32S3
        default RF_SENSE_IDENTIFY_LED_TYPE_NONE
        help
            Enables the /api/v1/identify endpoint used to map physical receiver placement.
            This endpoint is operational only: it must not affect CSI capture, OTA, or config.

        config RF_SENSE_IDENTIFY_LED_TYPE_NONE
            bool "No identify LED"

        config RF_SENSE_IDENTIFY_LED_TYPE_GPIO
            bool "Single GPIO LED"

        config RF_SENSE_IDENTIFY_LED_TYPE_WS2812
            bool "WS2812 / addressable RGB LED"
            depends on IDF_TARGET_ESP32S3
    endchoice

    config RF_SENSE_IDENTIFY_LED_GPIO
        int "Receiver identify LED GPIO"
        default 48 if IDF_TARGET_ESP32S3
        default 2
        range 0 48
        depends on !RF_SENSE_IDENTIFY_LED_TYPE_NONE
        help
            GPIO used by the receiver identify LED. ESP32-S3 dev boards commonly expose the
            onboard RGB LED on GPIO48.

    config RF_SENSE_IDENTIFY_LED_ACTIVE_HIGH
        bool "Single GPIO identify LED is active-high"
        default y
        depends on RF_SENSE_IDENTIFY_LED_TYPE_GPIO

endmenu
config RF_SENSE_CLASSIC_ESP32_EXPERIMENT
    bool "Enable disposable classic ESP32 experiment profile"
    default n
    help
        Uses reduced internal-RAM queues and an experimental board identity.
        Never enable this for the production ESP32-S3 build.
```

## firmware/sdkconfig.defaults
```kconfig
# Default sdkconfig for esp32-rf-sense-lab. Committed; the generated `sdkconfig` is NOT.
# Target: ESP32-S3-WROOM-1-N4R8 (4 MB flash, 8 MB octal PSRAM).

# --- Target / flash ---
CONFIG_IDF_TARGET="esp32s3"
CONFIG_ESPTOOLPY_FLASHSIZE_4MB=y
CONFIG_ESPTOOLPY_FLASHSIZE="4MB"
CONFIG_ESPTOOLPY_FLASHMODE_DIO=y
CONFIG_ESPTOOLPY_FLASHFREQ_80M=y

# --- Custom partition table (two large OTA slots) ---
CONFIG_PARTITION_TABLE_CUSTOM=y
CONFIG_PARTITION_TABLE_CUSTOM_FILENAME="partitions.csv"
CONFIG_PARTITION_TABLE_OFFSET=0x8000

# --- PSRAM (8 MB octal) ---
CONFIG_SPIRAM=y
CONFIG_SPIRAM_MODE_OCT=y
CONFIG_SPIRAM_SPEED_80M=y
CONFIG_SPIRAM_USE_MALLOC=y
CONFIG_SPIRAM_MALLOC_ALWAYSINTERNAL=16384
CONFIG_SPIRAM_TRY_ALLOCATE_WIFI_LWIP=y

# --- OTA application rollback (NOT irreversible anti-rollback) ---
CONFIG_BOOTLOADER_APP_ROLLBACK_ENABLE=y
# Explicitly DO NOT enable anti-rollback / secure boot / flash encryption during research.
# CONFIG_BOOTLOADER_APP_ANTI_ROLLBACK is intentionally left unset.

# --- Wi-Fi CSI ---
CONFIG_ESP_WIFI_CSI_ENABLED=y
CONFIG_ESP_WIFI_NVS_ENABLED=y

# --- HTTPS OTA / TLS ---
# Certificate bundle for the public-endpoint OTA path (the private-CA path embeds its own
# root and does not need the bundle, but enabling it keeps both options available).
CONFIG_MBEDTLS_CERTIFICATE_BUNDLE=y
CONFIG_MBEDTLS_CERTIFICATE_BUNDLE_DEFAULT_FULL=y
CONFIG_ESP_HTTPS_OTA_ALLOW_HTTP=n
CONFIG_ESP_TLS_INSECURE=n

# --- HTTP server (control API) ---
CONFIG_HTTPD_MAX_REQ_HDR_LEN=1024
CONFIG_HTTPD_MAX_URI_LEN=512

# --- ICMP ping (controlled mode) ---
CONFIG_LWIP_IPV4=y
CONFIG_LWIP_ICMP=y

# --- Runtime sizing ---
CONFIG_ESP_MAIN_TASK_STACK_SIZE=6144
CONFIG_FREERTOS_HZ=1000
CONFIG_ESP_TASK_WDT_EN=y
CONFIG_ESP_TASK_WDT_TIMEOUT_S=10
CONFIG_ESP_TASK_WDT_CHECK_IDLE_TASK_CPU0=n

# --- Coredump to the dedicated diagnostic partition ---
CONFIG_ESP_COREDUMP_ENABLE_TO_FLASH=y
CONFIG_ESP_COREDUMP_DATA_FORMAT_ELF=y
CONFIG_ESP_COREDUMP_CHECKSUM_CRC32=y

# --- Size-oriented build (must fit within one OTA slot with >=15% headroom) ---
CONFIG_COMPILER_OPTIMIZATION_SIZE=y
CONFIG_COMPILER_CXX_EXCEPTIONS=n
CONFIG_COMPILER_CXX_RTTI=n

# --- Logging ---
CONFIG_LOG_DEFAULT_LEVEL_INFO=y
CONFIG_LOG_MAXIMUM_LEVEL_DEBUG=y
```

## firmware/sdkconfig.defaults.esp32-experiment
```kconfig
# Disposable classic ESP32 experiment profile (4 MB flash, no PSRAM required).
# Build separately; do not use for ESP32-S3 production hardware.
CONFIG_IDF_TARGET="esp32"
CONFIG_RF_SENSE_CLASSIC_ESP32_EXPERIMENT=y
CONFIG_RF_SENSE_IDENTIFY_LED_TYPE_GPIO=y
CONFIG_RF_SENSE_IDENTIFY_LED_GPIO=2
CONFIG_RF_SENSE_IDENTIFY_LED_ACTIVE_HIGH=y
CONFIG_ESPTOOLPY_FLASHSIZE_4MB=y
CONFIG_ESPTOOLPY_FLASHSIZE="4MB"
CONFIG_ESPTOOLPY_FLASHMODE_DIO=y
CONFIG_ESPTOOLPY_FLASHFREQ_40M=y
CONFIG_PARTITION_TABLE_CUSTOM=y
CONFIG_PARTITION_TABLE_CUSTOM_FILENAME="partitions.csv"
CONFIG_PARTITION_TABLE_OFFSET=0x8000
# CONFIG_SPIRAM is not set
CONFIG_BOOTLOADER_APP_ROLLBACK_ENABLE=y
CONFIG_ESP_WIFI_CSI_ENABLED=y
CONFIG_ESP_WIFI_NVS_ENABLED=y
CONFIG_MBEDTLS_CERTIFICATE_BUNDLE=y
CONFIG_MBEDTLS_CERTIFICATE_BUNDLE_DEFAULT_FULL=y
CONFIG_ESP_HTTPS_OTA_ALLOW_HTTP=n
CONFIG_ESP_TLS_INSECURE=n
CONFIG_HTTPD_MAX_REQ_HDR_LEN=1024
CONFIG_HTTPD_MAX_URI_LEN=512
CONFIG_LWIP_IPV4=y
CONFIG_LWIP_ICMP=y
CONFIG_ESP_MAIN_TASK_STACK_SIZE=6144
CONFIG_FREERTOS_HZ=1000
CONFIG_ESP_TASK_WDT_EN=y
CONFIG_ESP_TASK_WDT_TIMEOUT_S=10
CONFIG_ESP_TASK_WDT_CHECK_IDLE_TASK_CPU0=n
CONFIG_ESP_COREDUMP_ENABLE_TO_FLASH=y
CONFIG_ESP_COREDUMP_DATA_FORMAT_ELF=y
CONFIG_ESP_COREDUMP_CHECKSUM_CRC32=y
CONFIG_COMPILER_OPTIMIZATION_SIZE=y
CONFIG_COMPILER_CXX_EXCEPTIONS=n
CONFIG_COMPILER_CXX_RTTI=n
CONFIG_LOG_DEFAULT_LEVEL_INFO=y
CONFIG_LOG_MAXIMUM_LEVEL_DEBUG=y
```
